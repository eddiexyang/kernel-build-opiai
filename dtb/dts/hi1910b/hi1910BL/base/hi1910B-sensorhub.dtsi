sensorhub0: sensorhub@80140000 {
	compatible = "hisilicon,hisi-sensorhub";
	reg = <0x0 0x80140000 0x0 0x1000 0x0 0xA6025000 0x0 0x1000 0x0 0xA40C2300 0x0 0x4 0x0 0x8000FFFC 0x0 0x4>;
	interrupts = <0 280 4>, <0 279 4>;
	status = "ok";
};
