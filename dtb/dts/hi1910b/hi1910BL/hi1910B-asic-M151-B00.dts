/dts-v1/;

/ {
	compatible = "hisilicon,hi1910B-evb", "hisilicon,ascend610";
	hisi,boardid = <0x0 0x0 0x0 0x1 0x5 0x1>;
	#address-cells = <0x2>;
	#size-cells = <0x2>;
	interrupt-parent = <0x1>;
	model = "Hisilicon PhosphorHi1910B evb";

	/include/ "base/hi1910B-asic-kernel-ep.dtsi"
	/include/ "base/hi1910B-commmon-smmu.dtsi"
	/include/ "base/hi1910B-mpam.dtsi"
	/include/ "base/hi1910B-lp-devmng.dtsi"
	/include/ "base/hi1910B-mbigen-ao.dtsi"
	// /include/ "base/hi1910B-pinctrl.dtsi"
	// /include/ "base/hi1910B-emmc.dtsi"
	/include/ "base/hi1910B-pcie.dtsi"
	/include/ "base/hi1910B-ipcdrv.dtsi"
	/include/ "base/hi1910B-ts-drv.dtsi"
	/include/ "base/hi1910B-tsdrv.dtsi"
	/include/ "base/hi1910B-hilink.dtsi"
	/include/ "base/hi1910B-mntn-milanr3.dtsi"
	/include/ "base/hi1910B-ctl.dtsi"
    /include/ "base/hi1910B-itrustee.dtsi"
	/include/ "base/hi1910B-ap-hiss.dtsi"
	/include/ "base/hi1910B-hidvpp.dtsi"
	/include/ "base/hi1910B-abl-qos.dtsi"

	chosen {
		bootargs = "console=ttyAMA0,115200 log_redirect=0x1fc000@0x22741000 rdinit=/sbin/init rodata=off syslog earlycon=pl011,mmio32,0xC4010000 initrd=0x2BA00000,300M mpam=of enable_ascend_share_pool ascend_enable_all enable_sp_multi_group_mode init_all_gicr enable_fpga module.sig_enforce=1 fbcon=map:6 movable_node";
	};
};
