/dts-v1/;

/ {
	compatible = "hisilicon,hi1910B-evb", "hisilicon,ascend610";
	hisi,boardid = <0x0 0x0 0x0 0x9 0x0 0x2>;
	#address-cells = <0x2>;
	#size-cells = <0x2>;
	interrupt-parent = <0x1>;
	model = "Hisilicon PhosphorHi1910B evb";

	/include/ "base/hi1910B-asic-kernel-rc.dtsi"
	/include/ "base/hi1910B-commmon-smmu.dtsi"
	/include/ "base/hi1910B-mpam.dtsi"
	/include/ "base/hi1910B-mntn-milanr3.dtsi"
    /include/ "base/hi1910B-itrustee.dtsi"
	/include/ "base/hi1910B-ap-hiss.dtsi"
	/include/ "base/hi1910B-abl-qos.dtsi"

	chosen {
		bootargs = "log_redirect=0x1fc000@0x22741000 rdinit=/sbin/init rodata=off syslog initrd=0x2BA00000,300M mpam=of enable_ascend_share_pool ascend_enable_all enable_sp_multi_group_mode init_all_gicr enable_fpga fbcon=map:6 movable_node";
	};
};
