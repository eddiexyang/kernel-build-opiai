/dts-v1/;

/ {
	compatible = "hisilicon,hi1910B-evb", "hisilicon,ascend610";
	hisi,boardid = <0x0 0x0 0x0 0x9 0x0 0x0>;
	#address-cells = <0x2>;
	#size-cells = <0x2>;
	interrupt-parent = <0x1>;
	model = "Hisilicon PhosphorHi1910B evb";

	/include/ "base/hi1910B-asic-kernel-rc.dtsi"
	/include/ "base/hi1910B-commmon-smmu.dtsi"
	/include/ "base/hi1910B-mpam.dtsi"
	/include/ "base/hi1910B-lp-pm.dtsi"
	/include/ "base/hi1910B-lp-devmng.dtsi"
	/include/ "base/hi1910B-mbigen-ao.dtsi"
	/include/ "base/hi1910B-hilink.dtsi"
	/include/ "base/hi1910B-pinctrl.dtsi"
	/include/ "base/hi1910B-gpio.dtsi"
	/include/ "base/hi1910B-i2c.dtsi"
	/include/ "base/hi1910B-spi.dtsi"
	// /include/ "base/hi1910B-bindcore.dtsi"
	// /include/ "base/hi1910B-can.dtsi"
	/include/ "base/hi1910B-sata.dtsi"
	/include/ "base/hi1910B-emmc.dtsi"
	/include/ "base/hi1910B-ipcdrv.dtsi"
	/include/ "base/hi1910B-ts-drv.dtsi"
	/include/ "base/hi1910B-tsdrv.dtsi"
	/include/ "base/hi1910B-network.dtsi"
	/include/ "base/hi1910B-hidvpp.dtsi"
	/include/ "base/hi1910B-hdmi.dtsi"
	/include/ "base/hi1910B-audio-900.dtsi"
	/include/ "base/hi1910B-mipitx.dtsi"
	/include/ "base/hi1910B-vdp.dtsi"
	/include/ "base/hi1910B-isp.dtsi"
	/include/ "base/hi1910B-sensorhub.dtsi"
	/include/ "base/hi1910B-mntn-milanr3.dtsi"
	/include/ "base/hi1910B-gpu.dtsi"
	/include/ "base/hi1910B-ctl.dtsi"
	/include/ "base/hi1910B-itrustee.dtsi"
	/include/ "base/hi1910B-ap-hiss.dtsi"
	/include/ "base/hi1910B-hiusbc.dtsi"
	/include/ "base/hi1910B-abl-qos.dtsi"

	chosen {
		bootargs = "log_redirect=0x1fc000@0x22741000 root=/dev/mmcblk0p2 rw rdinit=/sbin/init rodata=off syslog initrd=0x2BA00000,300M rootdelay=3 mpam=of enable_ascend_share_pool ascend_enable_all enable_sp_multi_group_mode init_all_gicr enable_fpga no_console_suspend selinux=0 fbcon=map:6 movable_node";
	};

};
