// SPDX-License-Identifier: GPL-2.0
/include/ "hi1910B-orangepiaipro20t.dts"

/* 24 GiB board: 2 GiB low RAM, 512 MiB TS RAM, 21.5 GiB high RAM.
 * Keep the TS node and all reserved-memory regions from the base tree.
 */
&{/memory0@numa0} {
	reg = <0x0 0x0 0x0 0x80000000>;
};

&{/memory1@numa0} {
	reg = <0x20 0xa0000000 0x5 0x60000000>;
};
